## config/west.yml
```yaml
manifest:
  remotes:
    - name: zmkfirmware
      url-base: https://github.com/zmkfirmware
    - name: munnich
      url-base: https://github.com/Nick-Munnich
    - name: caksoylar 
      url-base: https://github.com/caksoylar
    - name: carrefinho                            
      url-base: https://github.com/carrefinho
    # Additional modules containing boards/shields/custom code can be listed here as well
    # See https://docs.zephyrproject.org/3.2.0/develop/west/manifest.html#projects
  projects:
    - name: zmk
      remote: zmkfirmware
      revision: main
      import: app/west.yml
    - name: zmk-component-rp2040-zero
      remote: munnich
      revision: main
    - name: zmk-rgbled-widget 
      remote: caksoylar
      revision: main
    - name: prospector-zmk-module                 
      remote: carrefinho                          
      revision: main
  self:
    path: config
```
